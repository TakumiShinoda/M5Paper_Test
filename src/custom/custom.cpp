#include "./custom.h"

const uint8_t hoge[] = {
    0xFF,0xFF,0xFF,0xFF,0xFF,0xFF,0xFF,0xFF,0xFF,0xFF,0xFF,0xFF,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0xFF,
    0xFF,0x00,0x00,0x00,0x00,0x00,0x00,0x00,0x00,0x00,0x00,0x00,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0x00,
    0xFF,0x00,0x00,0x00,0x00,0x00,0x00,0x00,0x00,0x00,0x00,0x00,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0x00,
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    0xFF,0xFF,0xFF,0xFF,0xFF,0xFF,0xFF,0xFF,0xFF,0xFF,0xFF,0xFF,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0x00,
};

void View_TouchTest(){
    uint32_t Pos_LastTap[2] = {0xFFFFFFFF, 0xFFFFFFFF};
    uint32_t Pos_UpdateArea[2];
    uint32_t Size_UpdateArea[2];
    tp_finger_t Pos_Tapped;

    pinMode(M5EPD_KEY_LEFT_PIN, INPUT);

    while(true){
        M5.TP.update();
        M5.update();
        Pos_Tapped = M5.TP.readFinger(0);

        //Serial.printf("x: %u,y: %u", Pos_Tapped.x, Pos_Tapped.y);

        if(M5.BtnL.wasReleased() == true){
            M5.EPD.UpdateCount();
        }

        if(
            (Pos_Tapped.x < 540 && Pos_Tapped.x < 960) &&
            (Pos_LastTap[0] != Pos_Tapped.x || Pos_LastTap[1] != Pos_Tapped.y)
        ){
            M5.EPD.FillPartGram4bpp(Pos_LastTap[0] - 50, Pos_LastTap[1] - 50, 100, 100, 0xFFFF);
            M5.EPD.FillPartGram4bpp(Pos_Tapped.x - 50, Pos_Tapped.y - 50, 100, 100, 0x0000);

            Pos_UpdateArea[0] = (Pos_LastTap[0] < Pos_Tapped.x) ? Pos_LastTap[0] : Pos_Tapped.x;
            Pos_UpdateArea[1] = (Pos_LastTap[1] < Pos_Tapped.y) ? Pos_LastTap[1] : Pos_Tapped.y;
            Pos_UpdateArea[0] = ((int)Pos_UpdateArea[0] - (int)50 < 0) ? 0 : Pos_UpdateArea[0] - 50;
            Pos_UpdateArea[1] = ((int)Pos_UpdateArea[1] - (int)50 < 0) ? 0 : Pos_UpdateArea[1] - 50;

            Size_UpdateArea[0] = abs((int)Pos_LastTap[0] - (int)Pos_Tapped.x) + 110;
            Size_UpdateArea[1] = abs((int)Pos_LastTap[1] - (int)Pos_Tapped.y) + 110;

            M5.EPD.UpdateArea(Pos_UpdateArea[0], Pos_UpdateArea[1], Size_UpdateArea[0], Size_UpdateArea[1], UPDATE_MODE_DU);
            
            Pos_LastTap[0] = Pos_Tapped.x;
            Pos_LastTap[1] = Pos_Tapped.y;
        }
    }
}

void handler(ChainArray queries, ChainArray requests, String *response, WiFiClient *client){
    String test = requests.get("body");

    requests.showKeys(true);
    Serial.printf("[0] %hhu\n[1] %hhu\n", test[0], test[1]);
    //Serial.println(test);
    //SD.open(, "w");

    *response = "Success";
}

void View_CustomSystem(CustomSetups* setup){
    ServerObject server;
    ResponseHandler RespHandler("hoge", handler);
    M5EPD_Canvas Canvas_Batt(&M5.EPD);
    BattGauge Parts_BattGauge(540 - 40, 10, setup);
    Bar Parts_Bar(0, 50, setup);
    DigitalClock Parts_DigitalClock((540 / 2) - 45, 20, setup);
    HeapGauge Parts_HeapGauge(5, 30, setup);
    std::vector<uint8_t*> AppIcons = {
       (uint8_t*)ImageResource_main_icon_setting_92x92,
       (uint8_t*)ImageResource_main_icon_setting_92x92,
       (uint8_t*)ImageResource_main_icon_setting_92x92,
       (uint8_t*)ImageResource_main_icon_setting_92x92,
       (uint8_t*)ImageResource_main_icon_setting_92x92,
       (uint8_t*)ImageResource_main_icon_setting_92x92,
       (uint8_t*)ImageResource_main_icon_setting_92x92,
    };
    std::vector<Parts*> Parts_StatusBar = {
        &Parts_BattGauge,
        &Parts_DigitalClock,
        &Parts_Bar,
        &Parts_HeapGauge
    };
    std::vector<Parts*> Parts_Apps;
    AppArea appArea(Parts_StatusBar, setup);
    uint8_t AppIconRow = 0;
    uint8_t AppIconCol = 0;

    M5.BatteryADCBegin();
    Canvas_Batt.createCanvas(540, 100);
    Canvas_Batt.setTextSize(6);

    for(uint32_t i = 0; i < AppIcons.size(); i++){
        AppIconRow = i / 4;
        AppIconCol = i % 4;
        Parts_Apps.push_back(new RectButton(34 + ((34 + 92) * AppIconCol), (53 + 20) + ((53 + 92) * AppIconRow), 92, 92, AppIcons[i], setup));
    }
    // Parts_Apps.push_back(new RectButton(100, 100, 92, 92, AppIcons[0], setup));

    // Parts_BattGauge.setOverrideMode(false);
    // Parts_BattGauge.setOverrideValue(100);

    // CustomSetups::Wifi();
    // CustomSetups::MMC_SD();

    // server.addServer(80);
    // server.setResponse(80, "/hoge", &RespHandler, METHOD_POST);
    // server.openAllServers();

    uint64_t a = millis();
    uint16_t b;
    uint16_t c = 0xFFFF;

    AppInfo testA;
    uint8_t testB[100] = "hoge";
    InstructionParams::RenderRect testC = {100, 100, 120, 120, 0xFFFF};
    InstructionParams::RenderFillRect testE = {100, 100, 120, 120, 0xFFFF};
    InstructionParams::Jump testD = {0};

    testA.flag_buildin = true;
    testA.index_instruction = 0;
    testA.instructions = {
        // {InstructionCode::RENDER_RECT, &testC},
        {InstructionCode::RENDER_FILL_RECT, &testE},
        {InstructionCode::JUMP, &testD}
    };
    testA.str_appCode = testB;

    appArea.registerApp(testA);

    while(true){
        M5.update();
        // setup->update();

        Parts::updates(Parts_StatusBar);
        Parts::updates(Parts_Apps);
        Serial.printf("Heap: %u\n", heap_caps_get_free_size(MALLOC_CAP_INTERNAL));

        for(uint32_t i = 0; i < Parts_Apps.size(); i++){
            if(((RectButton*)Parts_Apps[i])->isReleased()){
                appArea.launchApp((uint8_t*)"hoge");
                Parts::inits(Parts_StatusBar);
                Parts::inits(Parts_Apps);
            }
        }

        // // Canvas_Batt.drawString(String((uint32_t)heap_caps_get_free_size(MALLOC_CAP_8BIT)), 0, 0);
        // // Canvas_Batt.pushCanvas(0, 300, UPDATE_MODE_DU4);

        // b = millis() - a;
        // Serial.println(b);
        // a = millis();

        // // Serial.println(heap_caps_get_free_size(MALLOC_CAP_8BIT));
        // // server.requestHandle(80);

        // if(M5.TP.avaliable()){
        //     M5.TP.update();
        // }

        vTaskDelay(1);
    }
}